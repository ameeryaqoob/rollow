## config/west.yml
```yaml
manifest:
  remotes:
    - name: zmkfirmware
      url-base: https://github.com/zmkfirmware
    - name: infused-kim
      url-base: https://github.com/infused-kim
    - name: petejohanson
      url-base: https://github.com/petejohanson
    - name: ameeryaqoob
      url-base: https://github.com/ameeryaqoob
  projects:
    - name: zmk
      remote: infused-kim
      revision: my-changes/split-encoder
      import: app/west.yml
  self:
    path: config
```
